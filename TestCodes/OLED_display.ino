#include <Wire.h>
#include <Adafruit_GFX.h>
#include <Adafruit_SSD1306.h>

#define SCREEN_WIDTH 128
#define SCREEN_HEIGHT 64

Adafruit_SSD1306 display(SCREEN_WIDTH, SCREEN_HEIGHT, &Wire, -1);

//==========================================================
// BITMAP 
//==========================================================

const unsigned char logo[] PROGMEM = {

  0x00, 0x00, 0x00, 0x00, 0x00, 0x00, 0x00, 0x00, 0x00, 0x00, 0x00, 0x00, 0x00, 0x00, 0x00, 0x00, 
	0x00, 0x00, 0x00, 0x00, 0x00, 0x00, 0x00, 0x00, 0x00, 0x00, 0x00, 0x00, 0x00, 0x00, 0x00, 0x00, 
	0x00, 0x00, 0x00, 0x00, 0x00, 0x00, 0x0f, 0xbc, 0x00, 0x00, 0x00, 0x00, 0x1f, 0xbf, 0x00, 0x00, 
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	0x00, 0x00, 0x00, 0x00, 0x00, 0x00, 0x00, 0x00

 
};



// Set your bitmap size
#define LOGO_WIDTH 48
#define LOGO_HEIGHT 52

//==========================================================
// PASTE YOUR TEXT ARRAY HERE
//==========================================================
const char* text[] = {
    "........",
    "",
    "This is a",
    "Test code for",
    "this OLED",
    "Display",
    "",
    "We are",
    "building a",
    "Project based",
    "on Structural",
    "Health Monitoring.",
    "",

    "Happy",
    "Building!",
    NULL
};

const int numLines = sizeof(text) / sizeof(text[0]);

//==========================================================
// TYPEWRITER SETTINGS
//==========================================================

const int MAX_VISIBLE_LINES = 8;

String visibleLines[MAX_VISIBLE_LINES];

int currentLine = 0;
int currentChar = 0;

unsigned long lastUpdate = 0;

const int TYPE_DELAY = 40;      // ms between characters
const int LINE_DELAY = 500;     // pause after each line
const int SPLASH_DELAY = 2500;

//==========================================================

void showSplashScreen() {

  display.clearDisplay();

  display.drawBitmap(
      4,
      (SCREEN_HEIGHT - LOGO_HEIGHT) / 2,
      logo,
      LOGO_WIDTH,
      LOGO_HEIGHT,
      WHITE);

  display.setTextColor(WHITE);

  display.setTextSize(1.5);
  display.setCursor(LOGO_WIDTH + 10, 18);
  display.println("JI TECH");

  display.setTextSize(1);
  display.setCursor(LOGO_WIDTH + 12, 40);
  display.println("Group 13");

  display.display();

  delay(SPLASH_DELAY);

  display.clearDisplay();
  display.display();
}

//==========================================================

void redrawScreen() {

  display.clearDisplay();

  display.setTextSize(1);
  display.setTextColor(WHITE);

  for (int i = 0; i < MAX_VISIBLE_LINES; i++) {

    display.setCursor(0, i * 8);
    display.println(visibleLines[i]);

  }

  display.display();

}

//==========================================================

void scrollUp() {

  for (int i = 0; i < MAX_VISIBLE_LINES - 1; i++) {

    visibleLines[i] = visibleLines[i + 1];

  }

  visibleLines[MAX_VISIBLE_LINES - 1] = "";

}

//==========================================================

void setup() {

  Serial.begin(115200);

  if (!display.begin(SSD1306_SWITCHCAPVCC, 0x3C)) {

    Serial.println("SSD1306 failed");

    while (1);

  }

  display.clearDisplay();

  showSplashScreen();

  for (int i = 0; i < MAX_VISIBLE_LINES; i++) {

    visibleLines[i] = "";

  }

}

//==========================================================

void loop() {

  static bool waiting = false;
  static unsigned long waitStart = 0;

  if (currentLine >= numLines) {

    delay(3000);

    currentLine = 0;
    currentChar = 0;

    for (int i = 0; i < MAX_VISIBLE_LINES; i++)
      visibleLines[i] = "";

    redrawScreen();

    return;

  }

  if (waiting) {

    if (millis() - waitStart >= LINE_DELAY) {

      waiting = false;

      if (MAX_VISIBLE_LINES > 0 &&
          visibleLines[MAX_VISIBLE_LINES - 1].length() > 0) {

        bool full = true;

        for (int i = 0; i < MAX_VISIBLE_LINES; i++) {

          if (visibleLines[i] == "") {

            full = false;
            break;

          }

        }

        if (full)
          scrollUp();

      }

      currentLine++;
      currentChar = 0;

    }

    return;

  }

  if (millis() - lastUpdate < TYPE_DELAY)
    return;

  lastUpdate = millis();

  const char *line = text[currentLine];

  int targetLine = 0;

  while (targetLine < MAX_VISIBLE_LINES &&
         visibleLines[targetLine] != "")
    targetLine++;

  if (targetLine >= MAX_VISIBLE_LINES)
    targetLine = MAX_VISIBLE_LINES - 1;

  if (currentChar < strlen(line)) {

    visibleLines[targetLine] += line[currentChar];
    currentChar++;

    redrawScreen();

  } else {

    waiting = true;
    waitStart = millis();

  }

}


